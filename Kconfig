## Kconfig
```kconfig
config DIARY_FS
	tristate "DiaryFS stackable file system (EXPERIMENTAL)"
	help
	  Diaryfs is a stackable file system which simply passes its
	  operations to the lower layer.  It is designed as a useful
	  template for developing or debugging other stackable file systems,
	  and more (see Documentation/filesystems/wrapfs.txt).  See
	  <http://wrapfs.filesystems.org/> for details.
```
